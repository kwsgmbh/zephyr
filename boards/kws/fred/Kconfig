## boards/kws/fred/Kconfig
```kconfig
# Copyright (c) 2024 KWS Computersysteme Gmbh
# SPDX-License-Identifier: Apache-2.0

config BOARD_FRED
	select RP2_FLASH_W25Q080
```

## boards/kws/fred/Kconfig.fred
```kconfig
# Copyright (c) 2024 KWS Computersysteme Gmbh
# SPDX-License-Identifier: Apache-2.0

config BOARD_FRED
	select SOC_RP2040
```

## boards/kws/fred/board.yml
```yaml
board:
  name: fred
  full_name: Fred-TheHandyman
  vendor: kws
  socs:
  - name: rp2040
```

## boards/kws/pico2_spe/Kconfig.pico2_spe
```kconfig
# Copyright (c) 2024 Andrew Featherstone
# SPDX-License-Identifier: Apache-2.0

config BOARD_PICO2_SPE
	select SOC_RP2350A_M33 if BOARD_PICO2_SPE_RP2350A_M33
```

## boards/kws/pico2_spe/board.yml
```yaml
board:
  name: pico2_spe
  full_name: Raspberry Pi Pico 2
  vendor: raspberrypi
  socs:
  - name: rp2350a
```
